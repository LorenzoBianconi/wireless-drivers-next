## Documentation/devicetree/bindings/net/wireless/mediatek,mt76.txt
```
* MediaTek mt76xx devices

This node provides properties for configuring the MediaTek mt76xx wireless
device. The node is expected to be specified as a child node of the PCI
controller to which the wireless chip is connected.

Alternatively, it can specify the wireless part of the MT7628/MT7688 or
MT7622 SoC. For SoC, use the following compatible strings:

compatible:
- "mediatek,mt7628-wmac" for MT7628/MT7688
- "mediatek,mt7622-wmac" for MT7622

properties:
- reg: Address and length of the register set for the device.
- interrupts: Main device interrupt

MT7622 specific properties:
- power-domains: phandle to the power domain that the WMAC is part of
- mediatek,infracfg: phandle to the infrastructure bus fabric syscon node

Optional properties:

- ieee80211-freq-limit: See ieee80211.txt
- mediatek,mtd-eeprom: Specify a MTD partition + offset containing EEPROM data
- big-endian: if the radio eeprom partition is written in big-endian, specify
  this property
- mediatek,eeprom-merge-otp: Merge EEPROM data with OTP data. Can be used on
  boards where the flash calibration data is generic and specific calibration
  data should be pulled from the OTP ROM

The MAC address can as well be set with corresponding optional properties
defined in net/ethernet.txt.

Optional nodes:
- led: Properties for a connected LED
  Optional properties:
    - led-sources: See Documentation/devicetree/bindings/leds/common.txt
- power-limits: contains per-regdomain/channel rate power limit subnodes

&pcie {
	pcie0 {
		wifi@0,0 {
			compatible = "mediatek,mt76";
			reg = <0x0000 0 0 0 0>;
			ieee80211-freq-limit = <5000000 6000000>;
			mediatek,mtd-eeprom = <&factory 0x8000>;
			big-endian;

			led {
				led-sources = <2>;
			};
		};
	};
};

MT7628 example:

wmac: wmac@10300000 {
	compatible = "mediatek,mt7628-wmac";
	reg = <0x10300000 0x100000>;

	interrupt-parent = <&cpuintc>;
	interrupts = <6>;

	mediatek,mtd-eeprom = <&factory 0x0000>;
};

MT7622 example:

wmac: wmac@18000000 {
	compatible = "mediatek,mt7622-wmac";
	reg = <0 0x18000000 0 0x100000>;
	interrupts = <GIC_SPI 211 IRQ_TYPE_LEVEL_LOW>;

	mediatek,infracfg = <&infracfg>;

	power-domains = <&scpsys MT7622_POWER_DOMAIN_WB>;
};


Subnodes of power-limits:

Properties:
- country: One or more country codes, as used by the cfg80211 regdomain code
- regdomain: "FCC", "ETSI" or "JP"

If neither country, nor regdomain is specified, the power limits node is used
as a fallback when no other subnode matches.

Subnodes txpower-2g, txpower-5g:

Properties:
- channels: pairs of first and last channel number
- cck: 4 half-dBm per-rate power limit values
- ofdm: 8 half-dBm per-rate power limit values
- mcs:
	sets of per-rate power limit values for 802.11n/802.11ac rates for
	multiple channel bandwidth settings.
	Each set starts with the number of channel bandwidth settings for
	which the rate set applies, followed by either 8 (MT7603/MT7628) or
	10 (all other chips) power limit values.
	The order of the channel bandwidth settings is: 20, 40, 80, 160 MHz.
- ru:
	sets of per-rate power limit values for 802.11ax rates for multiple
	channel bandwidth or resource unit settings.
	Each set starts with the number of channel bandwidth or resource unit
	settings for which the rate set applies, followed by 12 power limit
	values. The order of the channel resource unit settings is:
	RU26, RU52, RU106, RU242/SU20, RU484/SU40, RU996/SU80, RU2x996/SU160.
- txs-delta: half-dBm power delta for different numbers of antennas (1, 2, ...)


power-limit example:

power-limits {
	r0 {
		regdomain = "FCC";
		txpower-5g {
			r1 {
				channels = <36 48>;
				ofdm = <23 23 23 23 23 23 23 23>;
				mcs = <1 23 23 23 23 23 23 23 23 23 23>,
					  <3 22 22 22 22 22 22 22 22 22 22>;
				ru = <3 22 22 22 22 22 22 22 22 22 22 22 22>,
				     <4 20 20 20 20 20 20 20 20 20 20 20 20>;
			};
			r2 {
				channels = <100 181>;
				ofdm = <14 14 14 14 14 14 14 14>;
				mcs = <4 14 14 14 14 14 14 14 14 14 14>;
				txs-delta = <12 9 6>;
				ru = <7 14 14 14 14 14 14 14 14 14 14 14 14>;
			};
		};
	};
};
```

## Documentation/devicetree/bindings/net/wireless/mediatek,mt76.yaml
```yaml
# SPDX-License-Identifier: (GPL-2.0-only OR BSD-2-Clause)
# Copyright (c) 2018-2019 The Linux Foundation. All rights reserved.

%YAML 1.2
---
$id: http://devicetree.org/schemas/net/wireless/mediatek,mt76.yaml#
$schema: http://devicetree.org/meta-schemas/core.yaml#

title: MediaTek mt76 wireless devices Generic Binding

maintainers:
  - Felix Fietkau <nbd@nbd.name>
  - Lorenzo Bianconi <lorenzo@kernel.org>

description: |
  This node provides properties for configuring the MediaTek mt76xx
  wireless device. The node is expected to be specified as a child
  node of the PCI controller to which the wireless chip is connected.
  Alternatively, it can specify the wireless part of the MT7628/MT7688
  or MT7622 SoC.

properties:
  compatible:
    enum:
      - mediatek,mt76
      - mediatek,mt7628-wmac
      - mediatek,mt7622-wmac

  reg:
    maxItems: 1

  interrupts:
    maxItems: 1

  power-domains:
    maxItems: 1

  mediatek,infracfg:
    $ref: /schemas/types.yaml#/definitions/phandle
    description:
      Phandle to the infrastructure bus fabric syscon node.
      This property is MT7622 specific

  ieee80211-freq-limit:
    $ref: ieee80211.yaml#

  mediatek,mtd-eeprom:
    $ref: /schemas/types.yaml#/definitions/phandle-array
    description:
      Phandle to a MTD partition + offset containing EEPROM data

  big-endian:
    type: boolean
    description:
      Specify if the radio eeprom partition is written in big-endian

  mediatek,eeprom-merge-otp:
    type: boolean
    description:
      Merge EEPROM data with OTP data. Can be used on boards where the flash
      calibration data is generic and specific calibration data should be
      pulled from the OTP ROM

  led:
    type: object
    properties:
      led-sources:
        maxItems: 1
        $ref: /schemas/types.yaml#/definitions/uint32-array
        description:
          List of device current outputs the LED is connected to

required:
  - compatible
  - reg

additionalProperties: false

examples:
  - |
    pcie0 {
      #address-cells = <3>;
      #size-cells = <2>;
      wifi@0,0 {
        compatible = "mediatek,mt76";
        reg = <0x0000 0 0 0 0>;
        ieee80211-freq-limit = <5000000 6000000>;
        mediatek,mtd-eeprom = <&factory 0x8000>;
        big-endian;

        led {
          led-sources = <2>;
        };
      };
    };

  - |
    wmac: wmac@10300000 {
      compatible = "mediatek,mt7628-wmac";
      reg = <0x10300000 0x100000>;

      interrupt-parent = <&cpuintc>;
      interrupts = <6>;

      mediatek,mtd-eeprom = <&factory 0x0>;
    };

  - |
    wlmac: wmac@18000000 {
      compatible = "mediatek,mt7622-wmac";
      reg = <0x10300000 0x100000>;
      interrupts = <0 211 8>;

      mediatek,infracfg = <&infracfg>;

      power-domains = <&scpsys 3>;
    };
```

## drivers/net/wireless/mediatek/mt76/Kconfig
```kconfig
config MT76_CORE
	tristate
	select MAC80211_LEDS
	select LEDS_CLASS
	select NEW_LEDS

config MT76x2E
	tristate "MediaTek MT76x2E (PCIe) support"
	select MT76_CORE
	depends on MAC80211
	depends on PCI
	---help---
	  This adds support for MT7612/MT7602/MT7662-based wireless PCIe devices.
```

## drivers/net/wireless/mediatek/mt76/connac/Kconfig
```kconfig
# SPDX-License-Identifier: GPL-2.0-only
config CONNAC_COMMON
	select MT76_CORE
	tristate

config MT7663E
	tristate "MediaTek MT7663E (PCIE) support"
	select CONNAC_COMMON
	depends on MAC80211
	depends on PCI
	help
	  This adds support for MT7663E wireless devices.

	  To compile this driver as a module, choose M here.

config MT7663U
	tristate "MediaTek MT7663U (USB) support"
	select CONNAC_COMMON
	select MT76_USB
	depends on MAC80211
	depends on USB
	help
	  This adds support for MT7663U wireless devices.

	  To compile this driver as a module, choose M here.
```

## drivers/net/wireless/mediatek/mt76/mt7663/Kconfig
```kconfig
# SPDX-License-Identifier: GPL-2.0-only
config MT7663E
	tristate "MediaTek MT7663E (PCIE) support"
	select MT76_CORE
	depends on MAC80211
	depends on PCI
	help
	  This adds support for MT7663E wireless devices.

	  To compile this driver as a module, choose M here.
```
